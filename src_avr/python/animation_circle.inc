const __flash animation_data_t animation_circle[] = {
{{   0,   0, 166, 166,   0,   0,   0, 127, 239, 180}, .timeout = 15},
{{   2,   2, 248, 248,   0,   0,   0,  33, 254, 235}, .timeout = 15},
{{  45,  45,  88,  88,   0,   0,   0,   0, 231, 255}, .timeout = 15},
{{ 171, 171,   6,   6,   0,   0,  76,   0, 172, 235}, .timeout = 15},
{{ 255, 255, 166, 166,   0,   0, 163,   0,  87, 180}, .timeout = 15},
{{ 171, 171, 248, 248,   0,  97, 226,   0,   0,  97}, .timeout = 15},
{{  45,  45,  88,  88,   0, 180, 254,   0,   0,   0}, .timeout = 15},
{{   2,   2,   6,   6,  33, 235, 243,   0,   0,   0}, .timeout = 15},
{{   0,   0, 166, 166, 127, 255, 195,   0,   0,   0}, .timeout = 15},
{{   0,   0, 248, 248, 202, 235, 117,   0,   0,   0}, .timeout = 15},
{{   0,   0,  88,  88, 246, 180,  22,  65,   0,   0}, .timeout = 15},
{{   0,   0,   6,   6, 252,  97,   0, 155,   0,   0}, .timeout = 15},
{{   0,   0, 166, 166, 220,   0,   0, 220,   0,   0}, .timeout = 15},
{{   0,   0, 248, 248, 155,   0,   0, 252,  11,   0}, .timeout = 15},
{{   0,   0,  88,  88,  65,   0,   0, 246, 107,   0}, .timeout = 15},
{{   0,   0,   6,   6,   0,   0,   0, 202, 188,  97}, .timeout = 15},
};