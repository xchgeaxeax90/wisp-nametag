const __flash animation_data_t animation_blink[] = {
{{   0,   0, 127, 127, 127, 127, 127, 127, 127, 127}, .timeout = 16},
{{   0,   0, 138, 138, 132, 132, 132, 132, 132, 132}, .timeout = 16},
{{   0,   0, 148, 148, 137, 137, 137, 137, 137, 137}, .timeout = 16},
{{   2,   0, 157, 157, 142, 142, 142, 142, 142, 142}, .timeout = 16},
{{  17,   0, 165, 165, 146, 146, 146, 146, 146, 146}, .timeout = 16},
{{  69,   0, 171, 171, 149, 149, 149, 149, 149, 149}, .timeout = 16},
{{ 162,   0, 176, 176, 151, 151, 151, 151, 151, 151}, .timeout = 16},
{{ 242,   0, 178, 178, 152, 152, 152, 152, 152, 152}, .timeout = 16},
{{ 242,   0, 178, 178, 152, 152, 152, 152, 152, 152}, .timeout = 16},
{{ 162,   0, 176, 176, 151, 151, 151, 151, 151, 151}, .timeout = 16},
{{  69,   0, 171, 171, 149, 149, 149, 149, 149, 149}, .timeout = 16},
{{  17,   0, 165, 165, 146, 146, 146, 146, 146, 146}, .timeout = 16},
{{   2,   0, 157, 157, 142, 142, 142, 142, 142, 142}, .timeout = 16},
{{   0,   0, 148, 148, 137, 137, 137, 137, 137, 137}, .timeout = 16},
{{   0,   0, 138, 138, 132, 132, 132, 132, 132, 132}, .timeout = 16},
{{   0,   0, 127, 127, 127, 127, 127, 127, 127, 127}, .timeout = 16},
{{   0,   0, 116, 116, 122, 122, 122, 122, 122, 122}, .timeout = 16},
{{   0,   0, 106, 106, 117, 117, 117, 117, 117, 117}, .timeout = 16},
{{   0,   2,  97,  97, 112, 112, 112, 112, 112, 112}, .timeout = 16},
{{   0,  17,  89,  89, 108, 108, 108, 108, 108, 108}, .timeout = 16},
{{   0,  69,  83,  83, 105, 105, 105, 105, 105, 105}, .timeout = 16},
{{   0, 162,  78,  78, 103, 103, 103, 103, 103, 103}, .timeout = 16},
{{   0, 242,  76,  76, 102, 102, 102, 102, 102, 102}, .timeout = 16},
{{   0, 242,  76,  76, 102, 102, 102, 102, 102, 102}, .timeout = 16},
{{   0, 162,  78,  78, 103, 103, 103, 103, 103, 103}, .timeout = 16},
{{   0,  69,  83,  83, 105, 105, 105, 105, 105, 105}, .timeout = 16},
{{   0,  17,  89,  89, 108, 108, 108, 108, 108, 108}, .timeout = 16},
{{   0,   2,  97,  97, 112, 112, 112, 112, 112, 112}, .timeout = 16},
{{   0,   0, 106, 106, 117, 117, 117, 117, 117, 117}, .timeout = 16},
{{   0,   0, 116, 116, 122, 122, 122, 122, 122, 122}, .timeout = 16},
};