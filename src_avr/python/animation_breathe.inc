const __flash animation_data_t animation_breathe[] = {
{{   0,   0,   0,   0,   0,   0,   0,   0,   0,   0}, .timeout = 30},
{{  97,  97,  97,  97,  97,  97,  97,  97,  97,  97}, .timeout = 30},
{{ 180, 180, 180, 180, 180, 180, 180, 180, 180, 180}, .timeout = 30},
{{ 235, 235, 235, 235, 235, 235, 235, 235, 235, 235}, .timeout = 30},
{{ 255, 255, 255, 255, 255, 255, 255, 255, 255, 255}, .timeout = 30},
{{ 235, 235, 235, 235, 235, 235, 235, 235, 235, 235}, .timeout = 30},
{{ 180, 180, 180, 180, 180, 180, 180, 180, 180, 180}, .timeout = 30},
{{  97,  97,  97,  97,  97,  97,  97,  97,  97,  97}, .timeout = 30},
};