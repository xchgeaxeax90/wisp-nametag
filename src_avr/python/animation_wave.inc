const __flash animation_data_t animation_wave[] = {
{{   0,   0, 224, 222,  89, 254,  93, 109, 190, 152}, .timeout = 15},
{{  65,   0, 247, 183, 148, 248,  29, 165, 139,  93}, .timeout = 15},
{{ 127,   0, 254, 131, 197, 225,   0, 209,  79,  29}, .timeout = 15},
{{ 180,   0, 244,  70, 232, 186,   0, 240,  14,   0}, .timeout = 15},
{{ 220,   0, 217,   4, 251, 135,   0, 254,   0,   0}, .timeout = 15},
{{ 246,   0, 175,   0, 253,  74,   0, 250,   0,   0}, .timeout = 15},
{{ 255,   0, 121,   0, 238,   9,   0, 230,   0,   0}, .timeout = 15},
{{ 246,   0,  59,   0, 207,   0,   0, 194,   0,   0}, .timeout = 15},
{{ 220,   0,   0,   0, 161,   0,   0, 144,   0,   0}, .timeout = 15},
{{ 180,   0,   0,   0, 105,   0,   0,  85,   0,   0}, .timeout = 15},
{{ 127,   0,   0,   0,  41,   0,   0,  20,   0,   0}, .timeout = 15},
{{  65,   0,   0,   0,   0,   0,   0,   0,   0,   0}, .timeout = 15},
{{   0,   0,   0,   0,   0,   0,   0,   0,   0,   0}, .timeout = 15},
{{   0,  65,   0,   0,   0,   0,   0,   0,   0,   0}, .timeout = 15},
{{   0, 127,   0,   0,   0,   0,  37,   0,   0,   0}, .timeout = 15},
{{   0, 180,   0,   0,   0,   0, 101,   0,   0,  37}, .timeout = 15},
{{   0, 220,   0,   0,   0,   0, 158,   0,  52, 101}, .timeout = 15},
{{   0, 246,   0,  61,   0,   0, 204,   0, 115, 158}, .timeout = 15},
{{   0, 255,   0, 123,   0,   0, 237,   0, 170, 204}, .timeout = 15},
{{   0, 246,   0, 177,   0,  57, 253,   0, 213, 237}, .timeout = 15},
{{   0, 220,   6, 218,   0, 119, 252,   0, 242, 253}, .timeout = 15},
{{   0, 180,  72, 245,   0, 173, 233,   0, 254, 252}, .timeout = 15},
{{   0, 127, 133, 254,   0, 216, 199,   0, 249, 234}, .timeout = 15},
{{   0,  65, 184, 247,  25, 243, 151,  45, 227, 199}, .timeout = 15},
};